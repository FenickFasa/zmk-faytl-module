## boards/shields/faytl/Kconfig.defconfig
```kconfig
#if SHIELD_FAYTL_DONGLE
#
#config ZMK_KEYBOARD_NAME
#    default "FAYTL"
#
#config ZMK_SPLIT_ROLE_CENTRAL
#    default y
#
#endif # dongle

if SHIELD_FAYTL_LEFT

config ZMK_KEYBOARD_NAME
    default "FAYTL"

config ZMK_SPLIT_ROLE_CENTRAL
    default y

endif #left as central

if SHIELD_FAYTL_LEFT || SHIELD_FAYTL_RIGHT

config ZMK_SPLIT
    default y

endif # LEFT || RIGHT
```

## boards/shields/faytl/Kconfig.shield
```kconfig
# Copyright (c) 2026 Feneck Fasa
# SPDX-License-Identifier: MIT

config SHIELD_FAYTL_LEFT
    def_bool $(shields_list_contains,faytl_left)

config SHIELD_FAYTL_RIGHT
    def_bool $(shields_list_contains,faytl_right)

#config SHIELD_FAYTL_DONGLE
#    def_bool $(shields_list_contains,faytl_dongle)
```
